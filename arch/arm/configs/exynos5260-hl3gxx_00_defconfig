## drivers/battery/Kconfig
```kconfig
menuconfig POWER_SUPPLY
	tristate "Power supply class support"
	help
	  Say Y here to enable power supply class support. This allows
	  power supply (batteries, AC, USB) monitoring by userspace
	  via sysfs and uevent (if available) and/or APM kernel interface
	  (if selected below).

if POWER_SUPPLY

config BATTERY_SAMSUNG
	tristate "samsung battery driver"
	help
	 Say Y to include support for samsung battery driver
	 This battery driver integrated all battery-related functions
	 To see battery-related functions,
	 refer to sec_charging_common.h

config FUELGAUGE_RT5033
	tristate "RT5033 fuel gauge driver"
	depends on BATTERY_SAMSUNG
	help
	 Say Y to include support
	 for Richtek RT5033 fuel gauge driver.
	 This driver source code implemented
	 all functions for RT5033 fuel gauge.

config BATTERY_SAMSUNG_P1X
	tristate "samsung battery driver"
	help
	 Say Y to include support for samsung battery driver
	 This battery driver integrated all battery-related functions
	 To see battery-related functions,
	 refer to sec_charging_common.h

config SAMSUNG_LPM_MODE
	bool "Off charging mode support in sec battery driver"
	default n
	help
	 Say Y to include support for sec off charging support
	 This value defiend at bootloader.
	 Before enable this feature,
	 implement power off charging in the bootloader.

config SAMSUNG_BATTERY_ENG_TEST
	bool "enable ENG mode for battery test"
	default n
	help
	  Say Y to include support for battery test
	  enable this feature only ENG mode
	  this featuren must disabled user binary
	  stability test etc..

# Fuel Gauge

config FUELGAUGE_DUMMY
	tristate "dummy fuel gauge driver"
	default n
	depends on BATTERY_SAMSUNG_P1X
	help
	 Say Y to include support
	 for dummy fuel gauge driver.
	 This driver source code implemented
	 skeleton source code for fuel gauge functions.

config FUELGAUGE_ADC
	tristate "ADC fuel gauge driver"
	default n
	depends on BATTERY_SAMSUNG_P1X
	help
	 Say Y to include support
	 for ADC gauge driver.
	 This driver source code can be used for
	 fuel-gauge that is made of ADC.

config FUELGAUGE_MAX17042
	tristate "MAX17042 fuel gauge driver"
	default n
	depends on BATTERY_SAMSUNG_P1X
	help
	 Say Y to include support
	 for MAXIM MAX17042 fuel gauge driver.
	 This fuel-gauge can be used in voltage-tracking mode
	 or coulomb-counting mode.

config FUELGAUGE_MAX17042_VOLTAGE_TRACKING
	tristate "use MAX17042 fuel gauge only as voltage tracking"
	default n
	depends on FUELGAUGE_MAX17042
	help
	 Say Y to use MAX17042 fuel gauge
	 only as voltage tracking.
	 This mode is for target that consumes low current
	 like smart-phone.

config FUELGAUGE_MAX17042_COULOMB_COUNTING
	tristate "use MAX17042 fuel gauge as coulomb counting (including voltage tracking)"
	default n
	depends on FUELGAUGE_MAX17042
	help
	 Say Y to use MAX17042 fuel gauge
	 as coulomb counting (including voltage tracking).
	 This mode is for target that consumes high current
	 like tablet.

config FUELGAUGE_MAX17048
	tristate "MAX17048 fuel gauge driver"
	default n
	depends on BATTERY_SAMSUNG_P1X
	help
	 Say Y to include support
	 for MAXIM MAX17048 fuel gauge driver.
	 This fuel-gauge can be used
	 only in voltage-tracking mode.

config FUELGAUGE_MAX17050
	tristate "MAX17050 fuel gauge driver"
	default n
	depends on BATTERY_SAMSUNG_P1X
	help
	 Say Y to include support
	 for MAXIM MAX17047 or MAX17050 fuel gauge driver.
	 This fuel-gauge can be used in voltage-tracking mode
	 or coulomb-counting mode.

config FUELGAUGE_MAX17050_VOLTAGE_TRACKING
	tristate "use MAX17050 fuel gauge only as voltage tracking"
	default n
	depends on FUELGAUGE_MAX17050
	help
	 Say Y to use MAX17050 fuel gauge
	 only as voltage tracking.
	 This mode is for target that consumes low current
	 like smart-phone.

config FUELGAUGE_MAX17050_COULOMB_COUNTING
	tristate "use MAX17050 fuel gauge as coulomb counting (including voltage tracking)"
	default n
	depends on FUELGAUGE_MAX17050
	help
	 Say Y to use MAX17050 fuel gauge
	 as coulomb counting (including voltage tracking).
	 This mode is for target that consumes high current
	 like tablet.


# Charger

config CHARGER_MFD
	tristate "use mfd driver for charger driver"
	default n
	depends on BATTERY_SAMSUNG_P1X
	help
	 Say Y to include support
	 for charger driver with mfd.
	 This driver source code implemented
	 charger driver with mfd.

config CHARGER_DUMMY
	tristate "dummy charger driver"
	default n
	depends on BATTERY_SAMSUNG_P1X
	help
	 Say Y to include support
	 for dummy charger driver.
	 This driver source code implemented
	 skeleton source code for charger functions.

config CHARGER_MAX8903
	tristate "MAX8903 charger driver"
	default n
	depends on BATTERY_SAMSUNG_P1X
	help
	 Say Y to include support
	 for MAXIM MAX8903 charger driver.
	 This driver source code implemented
	 all functions for MAX8903 charger.

config CHARGER_SMB328
	tristate "SMB328 charger driver"
	default n
	depends on BATTERY_SAMSUNG_P1X
	help
	 Say Y to include support
	 for Summit SMB328 charger driver.
	 This driver source code implemented
	 all functions for SMB328 charger.

config CHARGER_SMB347
	tristate "SMB347 charger driver"
	default n
	depends on BATTERY_SAMSUNG_P1X
	help
	 Say Y to include support
	 for Summit SMB347 charger driver.
	 This driver source code implemented
	 all functions for SMB347 charger.

config CHARGER_SMB358
        tristate "SMB358 charger driver"
        depends on BATTERY_SAMSUNG_P1X
        help
         Say Y to include support
         for SMB358 charger driver.
         This driver source code implemented
         all functions for SMB358 charger.

config CHARGER_BQ24157
	tristate "BQ24157 charger driver"
	default n
	depends on BATTERY_SAMSUNG_P1X
	help
	 Say Y to include support
	 for TI BQ24157 charger driver.
	 This driver source code implemented
	 all functions for BQ24157 charger.

config CHARGER_BQ24190
	tristate "BQ24190 charger driver"
	default n
	depends on BATTERY_SAMSUNG_P1X
	help
	 Say Y to include support
	 for TI BQ24190 charger driver.
	 This driver source code implemented
	 all functions for BQ24190 charger.

config CHARGER_BQ24191
	tristate "BQ24191 charger driver"
	default n
	depends on BATTERY_SAMSUNG_P1X
	help
	 Say Y to include support
	 for TI BQ24191 charger driver.
	 This driver source code implemented
	 all functions for BQ24191 charger.

config CHARGER_BQ24260
	tristate "BQ24260 charger driver"
	default n
	depends on BATTERY_SAMSUNG_P1X
	help
	 Say Y to include support
	 for TI BQ24260 charger driver.
	 This driver source code implemented
	 all functions for BQ24260 charger.

config CHARGER_NCP1851
	tristate "NCP1851 charger driver"
	default n
	depends on BATTERY_SAMSUNG_P1X
	help
	 Say Y to include support
	 for NCP1851 charger driver.
	 This driver source code implemented
	 all functions for NCP1851 charger.

config CHARGER_TSU8111
	tristate "TSU8111 charger driver"
	default n
	depends on BATTERY_SAMSUNG_P1X
	help
	 Say Y to include support
	 for TSU8111 charger driver.
	 This driver source code implemented
	 all functions for TSU8111 charger.

config CHARGER_MAX14577
	tristate "MAX14577 charger driver"
	default n
	depends on BATTERY_SAMSUNG_P1X
	depends on CHARGER_MFD
	help
	 Say Y to include support
	 for MAX14577 charger driver.
	 This driver source code implemented
	 all functions for MAX14577 charger.

config CHARGER_MAX77693_BAT
        tristate "MAX77693 battery charger support"
        depends on BATTERY_SAMSUNG_P1X
	help
          Say Y here to enable support for the MAX77693 charger

endif # POWER_SUPPLY
```

## drivers/gpu/arm/mali400/mali/Kconfig
```kconfig
config MALI400_DEBUG
	bool "Enable debug in Mali driver"
	depends on MALI400
	---help---
	  This enabled extra debug checks and messages in the Mali driver.

config MALI400_PROFILING
	bool "Enable Mali profiling"
	depends on MALI400
	select TRACEPOINTS
	default n
	---help---
	  This enables gator profiling of Mali GPU events.

config MALI400_INTERNAL_PROFILING
	bool "Enable internal Mali profiling API"
	depends on MALI400_PROFILING
	default n
	---help---
	  This enables the internal legacy Mali profiling API.

config MALI400_UMP
	bool "Enable UMP support"
	depends on MALI400
	default n
	---help---
	  This enables support for the UMP memory sharing API in the Mali driver.

source "drivers/gpu/arm/mali400/ump/Kconfig"

config MALI_DVFS
	bool "Enables mali DVFS"
	depends on MALI400 && PM
	default n
	---help---
		This enables Mali driver DVFS.
```

## drivers/misc/clkmon/Kconfig
```kconfig
config CLK_MON
	bool "Clock Gate Monitor"
	default n
	help
		It is used to profiling clock gate and checking power domain.
```

## drivers/video/exynos/Kconfig
```kconfig
#
# Exynos Video configuration
#

menuconfig EXYNOS_VIDEO
	bool "Exynos Video driver support"
	help
	  This enables support for EXYNOS Video device.

if EXYNOS_VIDEO

#
# MIPI DSI driver
#

config EXYNOS_MIPI_DSI
	bool "EXYNOS MIPI DSI driver support."
	depends on ARCH_S5PV210 || ARCH_EXYNOS
	help
	  This enables support for MIPI-DSI device.

config EXYNOS_LCD_S6E8AX0
	bool "S6E8AX0 MIPI AMOLED LCD Driver"
	depends on (EXYNOS_MIPI_DSI && BACKLIGHT_CLASS_DEVICE && LCD_CLASS_DEVICE)
	default n
	help
	  If you have an S6E8AX0 MIPI AMOLED LCD Panel, say Y to enable its
	  LCD control driver.

config EXYNOS_LCD_S6E63J0X03
	bool "S6E63J0X03 MIPI AMOLED LCD Driver"
	depends on (EXYNOS_MIPI_DSI && BACKLIGHT_CLASS_DEVICE && LCD_CLASS_DEVICE)
	default n
	help
	  If you have an S6E63J0X03 MIPI AMOLED LCD Panel, say Y to enable its
	  LCD control driver.

config LCD_ESD
	bool "LCD ESD function"
	depends on EXYNOS_MIPI_DSI && BACKLIGHT_CLASS_DEVICE
	help
	  If you need a LCD ESD function to improve ESD stability,
	  Say Y to enable its ESD routine.
	  If ESD is detected, LCD will blink shortly.
	  This function depends on hardware support.

config EXYNOS_DP
	bool "EXYNOS DP driver support"
	depends on ARCH_EXYNOS
	default n
	help
	  This enables support for DP device.

config EXYNOS_SMIES
	bool "Samsung SMIES"
	depends on SOC_EXYNOS3250
	#select EXYNOS_SMIES_ENABLE_BOOTTIME

config EXYNOS_SMIES_ENABLE_BOOTTIME
	bool "Samsung SMIES Enable at Boot Time"
	depends on EXYNOS_SMIES

config EXYNOS_SMIES_DEFALUT_ENABLE
	bool "Samsung SMIES Block Default Enable"
	depends on (SOC_EXYNOS3250 && EXYNOS_SMIES)

endif # EXYNOS_VIDEO
```
